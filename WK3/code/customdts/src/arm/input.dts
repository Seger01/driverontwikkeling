# 1 "./src/arm/am335x-boneblack.dts"
# 1 "<built-in>"
# 1 "<command-line>"
# 1 "./src/arm/am335x-boneblack.dts"




/dts-v1/;

# 1 "./src/arm/am33xx.dtsi" 1
# 11 "./src/arm/am33xx.dtsi"
# 1 "./include/dt-bindings/gpio/gpio.h" 1
# 12 "./src/arm/am33xx.dtsi" 2
# 1 "./include/dt-bindings/pinctrl/am33xx.h" 1
# 9 "./include/dt-bindings/pinctrl/am33xx.h"
# 1 "./include/dt-bindings/pinctrl/omap.h" 1
# 10 "./include/dt-bindings/pinctrl/am33xx.h" 2
# 13 "./src/arm/am33xx.dtsi" 2
# 1 "./include/dt-bindings/clock/am3.h" 1
# 14 "./src/arm/am33xx.dtsi" 2

/ {
 compatible = "ti,am33xx";
 interrupt-parent = <&intc>;
 #address-cells = <1>;
 #size-cells = <1>;
 chosen { };

 aliases: aliases {
  i2c0 = &i2c0;
  i2c1 = &i2c1;
  i2c2 = &i2c2;
  serial0 = &uart0;
  serial1 = &uart1;
  serial2 = &uart2;
  serial3 = &uart3;
  serial4 = &uart4;
  serial5 = &uart5;
  d-can0 = &dcan0;
  d-can1 = &dcan1;
  usb0 = &usb0;
  usb1 = &usb1;
  phy0 = &usb0_phy;
  phy1 = &usb1_phy;
  ethernet0 = &cpsw_emac0;
  ethernet1 = &cpsw_emac1;
  spi0 = &spi0;
  spi1 = &spi1;
 };

 cpus {
  #address-cells = <1>;
  #size-cells = <0>;
  cpu@0 {
   compatible = "arm,cortex-a8";
   enable-method = "ti,am3352";
   device_type = "cpu";
   reg = <0>;

   operating-points-v2 = <&cpu0_opp_table>;

   clocks = <&dpll_mpu_ck>;
   clock-names = "cpu";

   clock-latency = <300000>;
   cpu-idle-states = <&mpu_gate>;
  };

  idle-states {
   mpu_gate: mpu_gate {
    compatible = "arm,idle-state";
    entry-latency-us = <40>;
    exit-latency-us = <90>;
    min-residency-us = <300>;
    ti,idle-wkup-m3;
   };
  };
 };

 cpu0_opp_table: opp-table {
  compatible = "operating-points-v2-ti-cpu";
  syscon = <&scm_conf>;






  opp50-300000000 {
   opp-hz = /bits/ 64 <300000000>;
   opp-microvolt = <950000 931000 969000>;
   opp-supported-hw = <0x06 0x0010>;
   opp-suspend;
  };

  opp100-275000000 {
   opp-hz = /bits/ 64 <275000000>;
   opp-microvolt = <1100000 1078000 1122000>;
   opp-supported-hw = <0x01 0x00FF>;
   opp-suspend;
  };

  opp100-300000000 {
   opp-hz = /bits/ 64 <300000000>;
   opp-microvolt = <1100000 1078000 1122000>;
   opp-supported-hw = <0x06 0x0020>;
   opp-suspend;
  };

  opp100-500000000 {
   opp-hz = /bits/ 64 <500000000>;
   opp-microvolt = <1100000 1078000 1122000>;
   opp-supported-hw = <0x01 0xFFFF>;
  };

  opp100-600000000 {
   opp-hz = /bits/ 64 <600000000>;
   opp-microvolt = <1100000 1078000 1122000>;
   opp-supported-hw = <0x06 0x0040>;
  };

  opp120-600000000 {
   opp-hz = /bits/ 64 <600000000>;
   opp-microvolt = <1200000 1176000 1224000>;
   opp-supported-hw = <0x01 0xFFFF>;
  };

  opp120-720000000 {
   opp-hz = /bits/ 64 <720000000>;
   opp-microvolt = <1200000 1176000 1224000>;
   opp-supported-hw = <0x06 0x0080>;
  };

  oppturbo-720000000 {
   opp-hz = /bits/ 64 <720000000>;
   opp-microvolt = <1260000 1234800 1285200>;
   opp-supported-hw = <0x01 0xFFFF>;
  };

  oppturbo-800000000 {
   opp-hz = /bits/ 64 <800000000>;
   opp-microvolt = <1260000 1234800 1285200>;
   opp-supported-hw = <0x06 0x0100>;
  };

  oppnitro-1000000000 {
   opp-hz = /bits/ 64 <1000000000>;
   opp-microvolt = <1325000 1298500 1351500>;
   opp-supported-hw = <0x04 0x0200>;
  };
 };

 pmu@4b000000 {
  compatible = "arm,cortex-a8-pmu";
  interrupts = <3>;
  reg = <0x4b000000 0x1000000>;
  ti,hwmods = "debugss";
 };





 soc {
  compatible = "ti,omap-infra";
  mpu {
   compatible = "ti,omap3-mpu";
   ti,hwmods = "mpu";
   pm-sram = <&pm_sram_code
       &pm_sram_data>;
  };
 };
# 174 "./src/arm/am33xx.dtsi"
 ocp: ocp {
  compatible = "simple-bus";
  #address-cells = <1>;
  #size-cells = <1>;
  ranges;
  ti,hwmods = "l3_main";

  l4_wkup: l4_wkup@44c00000 {
   compatible = "ti,am3-l4-wkup", "simple-bus";
   #address-cells = <1>;
   #size-cells = <1>;
   ranges = <0 0x44c00000 0x280000>;

   wkup_m3: wkup_m3@100000 {
    compatible = "ti,am3352-wkup-m3";
    reg = <0x100000 0x4000>,
          <0x180000 0x2000>;
    reg-names = "umem", "dmem";
    ti,hwmods = "wkup_m3";
    ti,pm-firmware = "am335x-pm-firmware.elf";
   };

   prcm: prcm@200000 {
    compatible = "ti,am3-prcm", "simple-bus";
    reg = <0x200000 0x4000>;
    #address-cells = <1>;
    #size-cells = <1>;
    ranges = <0 0x200000 0x4000>;

    prcm_clocks: clocks {
     #address-cells = <1>;
     #size-cells = <0>;
    };

    prcm_clockdomains: clockdomains {
    };
   };

   scm: scm@210000 {
    compatible = "ti,am3-scm", "simple-bus";
    reg = <0x210000 0x2000>;
    #address-cells = <1>;
    #size-cells = <1>;
    #pinctrl-cells = <1>;
    ranges = <0 0x210000 0x2000>;

    am33xx_pinmux: pinmux@800 {
     compatible = "pinctrl-single";
     reg = <0x800 0x238>;
     #address-cells = <1>;
     #size-cells = <0>;
     #pinctrl-cells = <1>;
     pinctrl-single,register-width = <32>;
     pinctrl-single,function-mask = <0x7f>;
    };

    scm_conf: scm_conf@0 {
     compatible = "syscon", "simple-bus";
     reg = <0x0 0x800>;
     #address-cells = <1>;
     #size-cells = <1>;
     ranges = <0 0 0x800>;

     scm_clocks: clocks {
      #address-cells = <1>;
      #size-cells = <0>;
     };
    };

    wkup_m3_ipc: wkup_m3_ipc@1324 {
     compatible = "ti,am3352-wkup-m3-ipc";
     reg = <0x1324 0x24>;
     interrupts = <78>;
     ti,rproc = <&wkup_m3>;
     mboxes = <&mailbox &mbox_wkupm3>;
    };

    edma_xbar: dma-router@f90 {
     compatible = "ti,am335x-edma-crossbar";
     reg = <0xf90 0x40>;
     #dma-cells = <3>;
     dma-requests = <32>;
     dma-masters = <&edma>;
    };

    scm_clockdomains: clockdomains {
    };
   };
  };

  intc: interrupt-controller@48200000 {
   compatible = "ti,am33xx-intc";
   interrupt-controller;
   #interrupt-cells = <1>;
   reg = <0x48200000 0x1000>;
  };

  edma: edma@49000000 {
   compatible = "ti,edma3-tpcc";
   ti,hwmods = "tpcc";
   reg = <0x49000000 0x10000>;
   reg-names = "edma3_cc";
   interrupts = <12 13 14>;
   interrupt-names = "edma3_ccint", "edma3_mperr",
       "edma3_ccerrint";
   dma-requests = <64>;
   #dma-cells = <2>;

   ti,tptcs = <&edma_tptc0 7>, <&edma_tptc1 5>,
       <&edma_tptc2 0>;

   ti,edma-memcpy-channels = <20 21>;
  };

  edma_tptc0: tptc@49800000 {
   compatible = "ti,edma3-tptc";
   ti,hwmods = "tptc0";
   reg = <0x49800000 0x100000>;
   interrupts = <112>;
   interrupt-names = "edma3_tcerrint";
  };

  edma_tptc1: tptc@49900000 {
   compatible = "ti,edma3-tptc";
   ti,hwmods = "tptc1";
   reg = <0x49900000 0x100000>;
   interrupts = <113>;
   interrupt-names = "edma3_tcerrint";
  };

  edma_tptc2: tptc@49a00000 {
   compatible = "ti,edma3-tptc";
   ti,hwmods = "tptc2";
   reg = <0x49a00000 0x100000>;
   interrupts = <114>;
   interrupt-names = "edma3_tcerrint";
  };

  gpio0: gpio@44e07000 {
   compatible = "ti,omap4-gpio";
   ti,hwmods = "gpio1";
   gpio-controller;
   #gpio-cells = <2>;
   interrupt-controller;
   #interrupt-cells = <2>;
   reg = <0x44e07000 0x1000>;
   interrupts = <96>;
   gpio-line-names =
    "MDIO_DATA",
    "MDIO_CLK",
    "SPI0_SCLK",
    "SPI0_D0",
    "SPI0_D1",
    "SPI0_CS0",
    "SPI0_CS1",
    "ECAP0_IN_PWM0_OUT",
    "LCD_DATA12",
    "LCD_DATA13",
    "LCD_DATA14",
    "LCD_DATA15",
    "UART1_CTSN",
    "UART1_RTSN",
    "UART1_RXD",
    "UART1_TXD",
    "GMII1_TXD3",
    "GMII1_TXD2",
    "USB0_DRVVBUS",
    "XDMA_EVENT_INTR0",
    "XDMA_EVENT_INTR1",
    "GMII1_TXD1",
    "GPMC_AD8",
    "GPMC_AD9",
    "NC",
    "NC",
    "GPMC_AD10",
    "GPMC_AD11",
    "GMII1_TXD0",
    "RMII1_REFCLK",
    "GPMC_WAIT0",
    "GPMC_WPN";
  };

  gpio1: gpio@4804c000 {
   compatible = "ti,omap4-gpio";
   ti,hwmods = "gpio2";
   gpio-controller;
   #gpio-cells = <2>;
   interrupt-controller;
   #interrupt-cells = <2>;
   reg = <0x4804c000 0x1000>;
   interrupts = <98>;
   gpio-line-names =
    "GPMC_AD0",
    "GPMC_AD1",
    "GPMC_AD2",
    "GPMC_AD3",
    "GPMC_AD4",
    "GPMC_AD5",
    "GPMC_AD6",
    "GPMC_AD7",
    "UART0_CTSN",
    "UART0_RTSN",
    "UART0_RXD",
    "UART0_TXD",
    "GPMC_AD12",
    "GPMC_AD13",
    "GPMC_AD14",
    "GPMC_AD15",
    "GPMC_A0",
    "GPMC_A1",
    "GPMC_A2",
    "GPMC_A3",
    "GPMC_A4",
    "GPMC_A5",
    "GPMC_A6",
    "GPMC_A7",
    "GPMC_A8",
    "GPMC_A9",
    "GPMC_A10",
    "GPMC_A11",
    "GPMC_BE1N",
    "GPMC_CSN0",
    "GPMC_CSN1",
    "GPMC_CSN2";
  };

  gpio2: gpio@481ac000 {
   compatible = "ti,omap4-gpio";
   ti,hwmods = "gpio3";
   gpio-controller;
   #gpio-cells = <2>;
   interrupt-controller;
   #interrupt-cells = <2>;
   reg = <0x481ac000 0x1000>;
   interrupts = <32>;
   gpio-line-names =
    "GPMC_CSN3",
    "GPMC_CLK",
    "GPMC_ADVN_ALE",
    "GPMC_OEN_REN",
    "GPMC_WEN",
    "GPMC_BE0N_CLE",
    "LCD_DATA0",
    "LCD_DATA1",
    "LCD_DATA2",
    "LCD_DATA3",
    "LCD_DATA4",
    "LCD_DATA5",
    "LCD_DATA6",
    "LCD_DATA7",
    "LCD_DATA8",
    "LCD_DATA9",
    "LCD_DATA10",
    "LCD_DATA11",
    "GMII1_RXD3",
    "GMII1_RXD2",
    "GMII1_RXD1",
    "GMII1_RXD0",
    "LCD_VSYNC",
    "LCD_HSYNC",
    "LCD_PCLK",
    "LCD_AC_BIAS_EN",
    "MMC0_DAT3",
    "MMC0_DAT2",
    "MMC0_DAT1",
    "MMC0_DAT0",
    "MMC0_CLK",
    "MMC0_CMD";
  };

  gpio3: gpio@481ae000 {
   compatible = "ti,omap4-gpio";
   ti,hwmods = "gpio4";
   gpio-controller;
   #gpio-cells = <2>;
   interrupt-controller;
   #interrupt-cells = <2>;
   reg = <0x481ae000 0x1000>;
   interrupts = <62>;
   gpio-line-names =
    "GMII1_COL",
    "GMII1_CRS",
    "GMII1_RXER",
    "GMII1_TXEN",
    "GMII1_RXDV",
    "I2C0_SDA",
    "I2C0_SCL",
    "EMU0",
    "EMU1",
    "GMII1_TXCLK",
    "GMII1_RXCLK",
    "NC",
    "NC",
    "USB1_DRVVBUS",
    "MCASP0_ACLKX",
    "MCASP0_FSX",
    "MCASP0_AXR0",
    "MCASP0_AHCLKR",
    "MCASP0_ACLKR",
    "MCASP0_FSR",
    "MCASP0_AXR1",
    "MCASP0_AHCLKX",
    "NC",
    "NC",
    "NC",
    "NC",
    "NC",
    "NC",
    "NC",
    "NC",
    "NC",
    "NC";
  };

  uart0: serial@44e09000 {
   compatible = "ti,am3352-uart", "ti,omap3-uart";
   ti,hwmods = "uart1";
   clock-frequency = <48000000>;
   reg = <0x44e09000 0x2000>;
   interrupts = <72>;
   status = "disabled";
   dmas = <&edma 26 0>, <&edma 27 0>;
   dma-names = "tx", "rx";
  };

  uart1: serial@48022000 {
   compatible = "ti,am3352-uart", "ti,omap3-uart";
   ti,hwmods = "uart2";
   clock-frequency = <48000000>;
   reg = <0x48022000 0x2000>;
   interrupts = <73>;
   status = "disabled";
   dmas = <&edma 28 0>, <&edma 29 0>;
   dma-names = "tx", "rx";
  };

  uart2: serial@48024000 {
   compatible = "ti,am3352-uart", "ti,omap3-uart";
   ti,hwmods = "uart3";
   clock-frequency = <48000000>;
   reg = <0x48024000 0x2000>;
   interrupts = <74>;
   status = "disabled";
   dmas = <&edma 30 0>, <&edma 31 0>;
   dma-names = "tx", "rx";
  };

  uart3: serial@481a6000 {
   compatible = "ti,am3352-uart", "ti,omap3-uart";
   ti,hwmods = "uart4";
   clock-frequency = <48000000>;
   reg = <0x481a6000 0x2000>;
   interrupts = <44>;
   status = "disabled";
  };

  uart4: serial@481a8000 {
   compatible = "ti,am3352-uart", "ti,omap3-uart";
   ti,hwmods = "uart5";
   clock-frequency = <48000000>;
   reg = <0x481a8000 0x2000>;
   interrupts = <45>;
   status = "disabled";
  };

  uart5: serial@481aa000 {
   compatible = "ti,am3352-uart", "ti,omap3-uart";
   ti,hwmods = "uart6";
   clock-frequency = <48000000>;
   reg = <0x481aa000 0x2000>;
   interrupts = <46>;
   status = "disabled";
  };

  i2c0: i2c@44e0b000 {
   compatible = "ti,omap4-i2c";
   #address-cells = <1>;
   #size-cells = <0>;
   ti,hwmods = "i2c1";
   reg = <0x44e0b000 0x1000>;
   interrupts = <70>;
   status = "disabled";
  };

  i2c1: i2c@4802a000 {
   compatible = "ti,omap4-i2c";
   #address-cells = <1>;
   #size-cells = <0>;
   ti,hwmods = "i2c2";
   reg = <0x4802a000 0x1000>;
   interrupts = <71>;
   status = "disabled";
  };

  i2c2: i2c@4819c000 {
   compatible = "ti,omap4-i2c";
   #address-cells = <1>;
   #size-cells = <0>;
   ti,hwmods = "i2c3";
   reg = <0x4819c000 0x1000>;
   interrupts = <30>;
   status = "disabled";
  };

  mmc1: mmc@48060000 {
   compatible = "ti,omap4-hsmmc";
   ti,hwmods = "mmc1";
   ti,dual-volt;
   ti,needs-special-reset;
   ti,needs-special-hs-handling;
   dmas = <&edma_xbar 24 0 0
    &edma_xbar 25 0 0>;
   dma-names = "tx", "rx";
   interrupts = <64>;
   reg = <0x48060000 0x1000>;
   status = "disabled";
  };

  mmc2: mmc@481d8000 {
   compatible = "ti,omap4-hsmmc";
   ti,hwmods = "mmc2";
   ti,needs-special-reset;
   dmas = <&edma 2 0
    &edma 3 0>;
   dma-names = "tx", "rx";
   interrupts = <28>;
   reg = <0x481d8000 0x1000>;
   status = "disabled";
  };

  mmc3: mmc@47810000 {
   compatible = "ti,omap4-hsmmc";
   ti,hwmods = "mmc3";
   ti,needs-special-reset;
   interrupts = <29>;
   reg = <0x47810000 0x1000>;
   status = "disabled";
  };

  hwspinlock: spinlock@480ca000 {
   compatible = "ti,omap4-hwspinlock";
   reg = <0x480ca000 0x1000>;
   ti,hwmods = "spinlock";
   #hwlock-cells = <1>;
  };

  wdt2: wdt@44e35000 {
   compatible = "ti,omap3-wdt";
   ti,hwmods = "wd_timer2";
   reg = <0x44e35000 0x1000>;
   interrupts = <91>;
  };

  dcan0: can@481cc000 {
   compatible = "ti,am3352-d_can";
   ti,hwmods = "d_can0";
   reg = <0x481cc000 0x2000>;
   clocks = <&dcan0_fck>;
   clock-names = "fck";
   syscon-raminit = <&scm_conf 0x644 0>;
   interrupts = <52>;
   status = "disabled";
  };

  dcan1: can@481d0000 {
   compatible = "ti,am3352-d_can";
   ti,hwmods = "d_can1";
   reg = <0x481d0000 0x2000>;
   clocks = <&dcan1_fck>;
   clock-names = "fck";
   syscon-raminit = <&scm_conf 0x644 1>;
   interrupts = <55>;
   status = "disabled";
  };

  mailbox: mailbox@480c8000 {
   compatible = "ti,omap4-mailbox";
   reg = <0x480C8000 0x200>;
   interrupts = <77>;
   ti,hwmods = "mailbox";
   #mbox-cells = <1>;
   ti,mbox-num-users = <4>;
   ti,mbox-num-fifos = <8>;
   mbox_wkupm3: wkup_m3 {
    ti,mbox-send-noirq;
    ti,mbox-tx = <0 0 0>;
    ti,mbox-rx = <0 0 3>;
   };
  };

  timer1: timer@44e31000 {
   compatible = "ti,am335x-timer-1ms";
   reg = <0x44e31000 0x400>;
   interrupts = <67>;
   ti,hwmods = "timer1";
   ti,timer-alwon;
   clocks = <&timer1_fck>;
   clock-names = "fck";
  };

  timer2: timer@48040000 {
   compatible = "ti,am335x-timer";
   reg = <0x48040000 0x400>;
   interrupts = <68>;
   ti,hwmods = "timer2";
   clocks = <&timer2_fck>;
   clock-names = "fck";
  };

  timer3: timer@48042000 {
   compatible = "ti,am335x-timer";
   reg = <0x48042000 0x400>;
   interrupts = <69>;
   ti,hwmods = "timer3";
  };

  timer4: timer@48044000 {
   compatible = "ti,am335x-timer";
   reg = <0x48044000 0x400>;
   interrupts = <92>;
   ti,hwmods = "timer4";
   ti,timer-pwm;
  };

  timer5: timer@48046000 {
   compatible = "ti,am335x-timer";
   reg = <0x48046000 0x400>;
   interrupts = <93>;
   ti,hwmods = "timer5";
   ti,timer-pwm;
  };

  timer6: timer@48048000 {
   compatible = "ti,am335x-timer";
   reg = <0x48048000 0x400>;
   interrupts = <94>;
   ti,hwmods = "timer6";
   ti,timer-pwm;
  };

  timer7: timer@4804a000 {
   compatible = "ti,am335x-timer";
   reg = <0x4804a000 0x400>;
   interrupts = <95>;
   ti,hwmods = "timer7";
   ti,timer-pwm;
  };

  rtc: rtc@44e3e000 {
   compatible = "ti,am3352-rtc", "ti,da830-rtc";
   reg = <0x44e3e000 0x1000>;
   interrupts = <75
          76>;
   ti,hwmods = "rtc";
   clocks = <&l4_per_clkctrl ((0x14c) - 0x14) 0>;
   clock-names = "int-clk";
  };

  spi0: spi@48030000 {
   compatible = "ti,omap4-mcspi";
   #address-cells = <1>;
   #size-cells = <0>;
   reg = <0x48030000 0x400>;
   interrupts = <65>;
   ti,spi-num-cs = <2>;
   ti,hwmods = "spi0";
   dmas = <&edma 16 0
    &edma 17 0
    &edma 18 0
    &edma 19 0>;
   dma-names = "tx0", "rx0", "tx1", "rx1";
   status = "disabled";
  };

  spi1: spi@481a0000 {
   compatible = "ti,omap4-mcspi";
   #address-cells = <1>;
   #size-cells = <0>;
   reg = <0x481a0000 0x400>;
   interrupts = <125>;
   ti,spi-num-cs = <2>;
   ti,hwmods = "spi1";
   dmas = <&edma 42 0
    &edma 43 0
    &edma 44 0
    &edma 45 0>;
   dma-names = "tx0", "rx0", "tx1", "rx1";
   status = "disabled";
  };

  usb: usb@47400000 {
   compatible = "ti,am33xx-usb";
   reg = <0x47400000 0x1000>;
   ranges;
   #address-cells = <1>;
   #size-cells = <1>;
   ti,hwmods = "usb_otg_hs";
   status = "disabled";

   usb_ctrl_mod: control@44e10620 {
    compatible = "ti,am335x-usb-ctrl-module";
    reg = <0x44e10620 0x10
     0x44e10648 0x4>;
    reg-names = "phy_ctrl", "wakeup";
    status = "disabled";
   };

   usb0_phy: usb-phy@47401300 {
    compatible = "ti,am335x-usb-phy";
    reg = <0x47401300 0x100>;
    reg-names = "phy";
    status = "disabled";
    ti,ctrl_mod = <&usb_ctrl_mod>;
    #phy-cells = <0>;
   };

   usb0: usb@47401000 {
    compatible = "ti,musb-am33xx";
    status = "disabled";
    reg = <0x47401400 0x400
     0x47401000 0x200>;
    reg-names = "mc", "control";

    interrupts = <18>;
    interrupt-names = "mc";
    dr_mode = "otg";
    mentor,multipoint = <1>;
    mentor,num-eps = <16>;
    mentor,ram-bits = <12>;
    mentor,power = <500>;
    phys = <&usb0_phy>;

    dmas = <&cppi41dma 0 0 &cppi41dma 1 0
     &cppi41dma 2 0 &cppi41dma 3 0
     &cppi41dma 4 0 &cppi41dma 5 0
     &cppi41dma 6 0 &cppi41dma 7 0
     &cppi41dma 8 0 &cppi41dma 9 0
     &cppi41dma 10 0 &cppi41dma 11 0
     &cppi41dma 12 0 &cppi41dma 13 0
     &cppi41dma 14 0 &cppi41dma 0 1
     &cppi41dma 1 1 &cppi41dma 2 1
     &cppi41dma 3 1 &cppi41dma 4 1
     &cppi41dma 5 1 &cppi41dma 6 1
     &cppi41dma 7 1 &cppi41dma 8 1
     &cppi41dma 9 1 &cppi41dma 10 1
     &cppi41dma 11 1 &cppi41dma 12 1
     &cppi41dma 13 1 &cppi41dma 14 1>;
    dma-names =
     "rx1", "rx2", "rx3", "rx4", "rx5", "rx6", "rx7",
     "rx8", "rx9", "rx10", "rx11", "rx12", "rx13",
     "rx14", "rx15",
     "tx1", "tx2", "tx3", "tx4", "tx5", "tx6", "tx7",
     "tx8", "tx9", "tx10", "tx11", "tx12", "tx13",
     "tx14", "tx15";
   };

   usb1_phy: usb-phy@47401b00 {
    compatible = "ti,am335x-usb-phy";
    reg = <0x47401b00 0x100>;
    reg-names = "phy";
    status = "disabled";
    ti,ctrl_mod = <&usb_ctrl_mod>;
    #phy-cells = <0>;
   };

   usb1: usb@47401800 {
    compatible = "ti,musb-am33xx";
    status = "disabled";
    reg = <0x47401c00 0x400
     0x47401800 0x200>;
    reg-names = "mc", "control";
    interrupts = <19>;
    interrupt-names = "mc";
    dr_mode = "otg";
    mentor,multipoint = <1>;
    mentor,num-eps = <16>;
    mentor,ram-bits = <12>;
    mentor,power = <500>;
    phys = <&usb1_phy>;

    dmas = <&cppi41dma 15 0 &cppi41dma 16 0
     &cppi41dma 17 0 &cppi41dma 18 0
     &cppi41dma 19 0 &cppi41dma 20 0
     &cppi41dma 21 0 &cppi41dma 22 0
     &cppi41dma 23 0 &cppi41dma 24 0
     &cppi41dma 25 0 &cppi41dma 26 0
     &cppi41dma 27 0 &cppi41dma 28 0
     &cppi41dma 29 0 &cppi41dma 15 1
     &cppi41dma 16 1 &cppi41dma 17 1
     &cppi41dma 18 1 &cppi41dma 19 1
     &cppi41dma 20 1 &cppi41dma 21 1
     &cppi41dma 22 1 &cppi41dma 23 1
     &cppi41dma 24 1 &cppi41dma 25 1
     &cppi41dma 26 1 &cppi41dma 27 1
     &cppi41dma 28 1 &cppi41dma 29 1>;
    dma-names =
     "rx1", "rx2", "rx3", "rx4", "rx5", "rx6", "rx7",
     "rx8", "rx9", "rx10", "rx11", "rx12", "rx13",
     "rx14", "rx15",
     "tx1", "tx2", "tx3", "tx4", "tx5", "tx6", "tx7",
     "tx8", "tx9", "tx10", "tx11", "tx12", "tx13",
     "tx14", "tx15";
   };

   cppi41dma: dma-controller@47402000 {
    compatible = "ti,am3359-cppi41";
    reg = <0x47400000 0x1000
     0x47402000 0x1000
     0x47403000 0x1000
     0x47404000 0x4000>;
    reg-names = "glue", "controller", "scheduler", "queuemgr";
    interrupts = <17>;
    interrupt-names = "glue";
    #dma-cells = <2>;
    #dma-channels = <30>;
    #dma-requests = <256>;
    status = "disabled";
   };
  };

  epwmss0: epwmss@48300000 {
   compatible = "ti,am33xx-pwmss";
   reg = <0x48300000 0x10>;
   ti,hwmods = "epwmss0";
   #address-cells = <1>;
   #size-cells = <1>;
   status = "disabled";
   ranges = <0x48300100 0x48300100 0x80
      0x48300180 0x48300180 0x80
      0x48300200 0x48300200 0x80>;

   ecap0: ecap@48300100 {
    compatible = "ti,am3352-ecap",
          "ti,am33xx-ecap";
    #pwm-cells = <3>;
    reg = <0x48300100 0x80>;
    clocks = <&l4ls_gclk>;
    clock-names = "fck";
    interrupts = <31>;
    interrupt-names = "ecap0";
    status = "disabled";
   };

   eqep0: eqep@0x48300180 {
    compatible = "ti,am33xx-eqep";
    reg = <0x48300180 0x80>;
    clocks = <&l4ls_gclk>;
    clock-names = "fck";
    interrupt-parent = <&intc>;
    interrupts = <79>;
    status = "disabled";
   };

   ehrpwm0: pwm@48300200 {
    compatible = "ti,am3352-ehrpwm",
          "ti,am33xx-ehrpwm";
    #pwm-cells = <3>;
    reg = <0x48300200 0x80>;
    clocks = <&ehrpwm0_tbclk>, <&l4ls_gclk>;
    clock-names = "tbclk", "fck";
    status = "disabled";
   };
  };

  epwmss1: epwmss@48302000 {
   compatible = "ti,am33xx-pwmss";
   reg = <0x48302000 0x10>;
   ti,hwmods = "epwmss1";
   #address-cells = <1>;
   #size-cells = <1>;
   status = "disabled";
   ranges = <0x48302100 0x48302100 0x80
      0x48302180 0x48302180 0x80
      0x48302200 0x48302200 0x80>;

   ecap1: ecap@48302100 {
    compatible = "ti,am3352-ecap",
          "ti,am33xx-ecap";
    #pwm-cells = <3>;
    reg = <0x48302100 0x80>;
    clocks = <&l4ls_gclk>;
    clock-names = "fck";
    interrupts = <47>;
    interrupt-names = "ecap1";
    status = "disabled";
   };

   eqep1: eqep@0x48302180 {
    compatible = "ti,am33xx-eqep";
    reg = <0x48302180 0x80>;
    clocks = <&l4ls_gclk>;
    clock-names = "fck";
    interrupt-parent = <&intc>;
    interrupts = <88>;
    status = "disabled";
   };

   ehrpwm1: pwm@48302200 {
    compatible = "ti,am3352-ehrpwm",
          "ti,am33xx-ehrpwm";
    #pwm-cells = <3>;
    reg = <0x48302200 0x80>;
    clocks = <&ehrpwm1_tbclk>, <&l4ls_gclk>;
    clock-names = "tbclk", "fck";
    status = "disabled";
   };
  };

  epwmss2: epwmss@48304000 {
   compatible = "ti,am33xx-pwmss";
   reg = <0x48304000 0x10>;
   ti,hwmods = "epwmss2";
   #address-cells = <1>;
   #size-cells = <1>;
   status = "disabled";
   ranges = <0x48304100 0x48304100 0x80
      0x48304180 0x48304180 0x80
      0x48304200 0x48304200 0x80>;

   ecap2: ecap@48304100 {
    compatible = "ti,am3352-ecap",
          "ti,am33xx-ecap";
    #pwm-cells = <3>;
    reg = <0x48304100 0x80>;
    clocks = <&l4ls_gclk>;
    clock-names = "fck";
    interrupts = <61>;
    interrupt-names = "ecap2";
    status = "disabled";
   };

   eqep2: eqep@0x48304180 {
    compatible = "ti,am33xx-eqep";
    reg = <0x48304180 0x80>;
    clocks = <&l4ls_gclk>;
    clock-names = "fck";
    interrupt-parent = <&intc>;
    interrupts = <89>;
    status = "disabled";
   };

   ehrpwm2: pwm@48304200 {
    compatible = "ti,am3352-ehrpwm",
          "ti,am33xx-ehrpwm";
    #pwm-cells = <3>;
    reg = <0x48304200 0x80>;
    clocks = <&ehrpwm2_tbclk>, <&l4ls_gclk>;
    clock-names = "tbclk", "fck";
    status = "disabled";
   };
  };

  mac: ethernet@4a100000 {
   compatible = "ti,am335x-cpsw","ti,cpsw";
   ti,hwmods = "cpgmac0";
   clocks = <&cpsw_125mhz_gclk>, <&cpsw_cpts_rft_clk>;
   clock-names = "fck", "cpts";
   cpdma_channels = <8>;
   ale_entries = <1024>;
   bd_ram_size = <0x2000>;
   mac_control = <0x20>;
   slaves = <2>;
   active_slave = <0>;
   cpts_clock_mult = <0x80000000>;
   cpts_clock_shift = <29>;
   reg = <0x4a100000 0x800
          0x4a101200 0x100>;
   #address-cells = <1>;
   #size-cells = <1>;






   interrupts = <40 41 42 43>;
   ranges;
   syscon = <&scm_conf>;
   status = "disabled";

   davinci_mdio: mdio@4a101000 {
    compatible = "ti,cpsw-mdio","ti,davinci_mdio";
    #address-cells = <1>;
    #size-cells = <0>;
    ti,hwmods = "davinci_mdio";
    bus_freq = <1000000>;
    reg = <0x4a101000 0x100>;
    status = "disabled";
   };

   cpsw_emac0: slave@4a100200 {

    mac-address = [ 00 00 00 00 00 00 ];
   };

   cpsw_emac1: slave@4a100300 {

    mac-address = [ 00 00 00 00 00 00 ];
   };

   phy_sel: cpsw-phy-sel@44e10650 {
    compatible = "ti,am3352-cpsw-phy-sel";
    reg= <0x44e10650 0x4>;
    reg-names = "gmii-sel";
   };
  };

  ocmcram: ocmcram@40300000 {
   compatible = "mmio-sram";
   reg = <0x40300000 0x10000>;
   ranges = <0x0 0x40300000 0x10000>;
   #address-cells = <1>;
   #size-cells = <1>;

   pm_sram_code: pm-sram-code@0 {
    compatible = "ti,sram";
    reg = <0x0 0x1000>;
    protect-exec;
   };

   pm_sram_data: pm-sram-data@1000 {
    compatible = "ti,sram";
    reg = <0x1000 0x1000>;
    pool;
   };
  };

  pruss_soc_bus: pruss-soc-bus@4a326004 {
   compatible = "ti,am3356-pruss-soc-bus";
   reg = <0x4a326004 0x4>;
   ti,hwmods = "pruss";
   #address-cells = <1>;
   #size-cells = <1>;
   ranges;
   status = "disabled";

   pruss: pruss@4a300000 {
    compatible = "ti,am3356-pruss";
    reg = <0x4a300000 0x80000>;
    interrupts = <20 21 22 23 24 25 26 27>;
    interrupt-names = "host2", "host3", "host4",
        "host5", "host6", "host7",
        "host8", "host9";
    #address-cells = <1>;
    #size-cells = <1>;
    ranges;
    status = "disabled";

    pruss_mem: memories@4a300000 {
     reg = <0x4a300000 0x2000>,
           <0x4a302000 0x2000>,
           <0x4a310000 0x3000>;
     reg-names = "dram0", "dram1",
          "shrdram2";
    };

    pruss_cfg: cfg@4a326000 {
     compatible = "syscon";
     reg = <0x4a326000 0x2000>;
    };

    pruss_iep: iep@4a32e000 {
     compatible = "syscon";
     reg = <0x4a32e000 0x31c>;
    };

    pruss_mii_rt: mii-rt@4a332000 {
     compatible = "syscon";
     reg = <0x4a332000 0x58>;
    };

    pruss_intc: interrupt-controller@4a320000 {
     compatible = "ti,am3356-pruss-intc";
     reg = <0x4a320000 0x2000>;
     interrupt-controller;
     #interrupt-cells = <1>;
    };

    pru0: pru@4a334000 {
     compatible = "ti,am3356-pru";
     reg = <0x4a334000 0x2000>,
           <0x4a322000 0x400>,
           <0x4a322400 0x100>;
     reg-names = "iram", "control", "debug";
     firmware-name = "am335x-pru0-fw";
     interrupt-parent = <&pruss_intc>;
     interrupts = <16>, <17>;
     interrupt-names = "vring", "kick";
    };

    pru1: pru@4a338000 {
     compatible = "ti,am3356-pru";
     reg = <0x4a338000 0x2000>,
           <0x4a324000 0x400>,
           <0x4a324400 0x100>;
     reg-names = "iram", "control", "debug";
     firmware-name = "am335x-pru1-fw";
     interrupt-parent = <&pruss_intc>;
     interrupts = <18>, <19>;
     interrupt-names = "vring", "kick";
    };

    pruss_mdio: mdio@4a332400 {
     compatible = "ti,davinci_mdio";
     reg = <0x4a332400 0x90>;
     clocks = <&dpll_core_m4_ck>;
     clock-names = "fck";
     bus_freq = <1000000>;
     #address-cells = <1>;
     #size-cells = <0>;
     status = "disabled";
    };
   };
  };

  elm: elm@48080000 {
   compatible = "ti,am3352-elm";
   reg = <0x48080000 0x2000>;
   interrupts = <4>;
   ti,hwmods = "elm";
   status = "disabled";
  };

  lcdc: lcdc@4830e000 {
   compatible = "ti,am33xx-tilcdc";
   reg = <0x4830e000 0x1000>;
   interrupts = <36>;
   ti,hwmods = "lcdc";
   status = "disabled";
  };

  tscadc: tscadc@44e0d000 {
   compatible = "ti,am3359-tscadc";
   reg = <0x44e0d000 0x1000>;
   interrupts = <16>;
   ti,hwmods = "adc_tsc";
   status = "disabled";
   dmas = <&edma 53 0>, <&edma 57 0>;
   dma-names = "fifo0", "fifo1";

   tsc {
    compatible = "ti,am3359-tsc";
   };
   am335x_adc: adc {
    #io-channel-cells = <1>;
    compatible = "ti,am3359-adc";
   };
  };

  emif: emif@4c000000 {
   compatible = "ti,emif-am3352";
   reg = <0x4c000000 0x1000000>;
   ti,hwmods = "emif";
   interrupts = <101>;
   sram = <&pm_sram_code
    &pm_sram_data>;
   ti,no-idle;
  };

  gpmc: gpmc@50000000 {
   compatible = "ti,am3352-gpmc";
   ti,hwmods = "gpmc";
   ti,no-idle-on-init;
   reg = <0x50000000 0x2000>;
   interrupts = <100>;
   dmas = <&edma 52 0>;
   dma-names = "rxtx";
   gpmc,num-cs = <7>;
   gpmc,num-waitpins = <2>;
   #address-cells = <2>;
   #size-cells = <1>;
   interrupt-controller;
   #interrupt-cells = <2>;
   gpio-controller;
   #gpio-cells = <2>;
   status = "disabled";
  };

  sham: sham@53100000 {
   compatible = "ti,omap4-sham";
   ti,hwmods = "sham";
   reg = <0x53100000 0x200>;
   interrupts = <109>;
   dmas = <&edma 36 0>;
   dma-names = "rx";
  };

  aes: aes@53500000 {
   compatible = "ti,omap4-aes";
   ti,hwmods = "aes";
   reg = <0x53500000 0xa0>;
   interrupts = <103>;
   dmas = <&edma 6 0>,
          <&edma 5 0>;
   dma-names = "tx", "rx";
  };

  mcasp0: mcasp@48038000 {
   compatible = "ti,am33xx-mcasp-audio";
   ti,hwmods = "mcasp0";
   reg = <0x48038000 0x2000>,
         <0x46000000 0x400000>;
   reg-names = "mpu", "dat";
   interrupts = <80>, <81>;
   interrupt-names = "tx", "rx";
   status = "disabled";
   dmas = <&edma 8 2>,
    <&edma 9 2>;
   dma-names = "tx", "rx";
  };

  mcasp1: mcasp@4803c000 {
   compatible = "ti,am33xx-mcasp-audio";
   ti,hwmods = "mcasp1";
   reg = <0x4803C000 0x2000>,
         <0x46400000 0x400000>;
   reg-names = "mpu", "dat";
   interrupts = <82>, <83>;
   interrupt-names = "tx", "rx";
   status = "disabled";
   dmas = <&edma 10 2>,
    <&edma 11 2>;
   dma-names = "tx", "rx";
  };

  rng: rng@48310000 {
   compatible = "ti,omap4-rng";
   ti,hwmods = "rng";
   reg = <0x48310000 0x2000>;
   interrupts = <111>;
  };

  sgx: sgx@56000000 {
   compatible = "ti,am3352-sgx530", "img,sgx530";
   ti,hwmods = "gfx";
   reg = <0x56000000 0x10000>;
   interrupts = <37>;
   clocks = <&gfx_fck_div_ck>;
   clock-names = "fclk";
   status = "disabled";
  };
 };
};

# 1 "./src/arm/am33xx-clocks.dtsi" 1
# 10 "./src/arm/am33xx-clocks.dtsi"
&scm_clocks {
 sys_clkin_ck: sys_clkin_ck@40 {
  #clock-cells = <0>;
  compatible = "ti,mux-clock";
  clocks = <&virt_19200000_ck>, <&virt_24000000_ck>, <&virt_25000000_ck>, <&virt_26000000_ck>;
  ti,bit-shift = <22>;
  reg = <0x0040>;
 };

 adc_tsc_fck: adc_tsc_fck {
  #clock-cells = <0>;
  compatible = "fixed-factor-clock";
  clocks = <&sys_clkin_ck>;
  clock-mult = <1>;
  clock-div = <1>;
 };

 dcan0_fck: dcan0_fck {
  #clock-cells = <0>;
  compatible = "fixed-factor-clock";
  clocks = <&sys_clkin_ck>;
  clock-mult = <1>;
  clock-div = <1>;
 };

 dcan1_fck: dcan1_fck {
  #clock-cells = <0>;
  compatible = "fixed-factor-clock";
  clocks = <&sys_clkin_ck>;
  clock-mult = <1>;
  clock-div = <1>;
 };

 mcasp0_fck: mcasp0_fck {
  #clock-cells = <0>;
  compatible = "fixed-factor-clock";
  clocks = <&sys_clkin_ck>;
  clock-mult = <1>;
  clock-div = <1>;
 };

 mcasp1_fck: mcasp1_fck {
  #clock-cells = <0>;
  compatible = "fixed-factor-clock";
  clocks = <&sys_clkin_ck>;
  clock-mult = <1>;
  clock-div = <1>;
 };

 smartreflex0_fck: smartreflex0_fck {
  #clock-cells = <0>;
  compatible = "fixed-factor-clock";
  clocks = <&sys_clkin_ck>;
  clock-mult = <1>;
  clock-div = <1>;
 };

 smartreflex1_fck: smartreflex1_fck {
  #clock-cells = <0>;
  compatible = "fixed-factor-clock";
  clocks = <&sys_clkin_ck>;
  clock-mult = <1>;
  clock-div = <1>;
 };

 sha0_fck: sha0_fck {
  #clock-cells = <0>;
  compatible = "fixed-factor-clock";
  clocks = <&sys_clkin_ck>;
  clock-mult = <1>;
  clock-div = <1>;
 };

 aes0_fck: aes0_fck {
  #clock-cells = <0>;
  compatible = "fixed-factor-clock";
  clocks = <&sys_clkin_ck>;
  clock-mult = <1>;
  clock-div = <1>;
 };

 rng_fck: rng_fck {
  #clock-cells = <0>;
  compatible = "fixed-factor-clock";
  clocks = <&sys_clkin_ck>;
  clock-mult = <1>;
  clock-div = <1>;
 };

 ehrpwm0_tbclk: ehrpwm0_tbclk@44e10664 {
  #clock-cells = <0>;
  compatible = "ti,gate-clock";
  clocks = <&l4ls_gclk>;
  ti,bit-shift = <0>;
  reg = <0x0664>;
 };

 ehrpwm1_tbclk: ehrpwm1_tbclk@44e10664 {
  #clock-cells = <0>;
  compatible = "ti,gate-clock";
  clocks = <&l4ls_gclk>;
  ti,bit-shift = <1>;
  reg = <0x0664>;
 };

 ehrpwm2_tbclk: ehrpwm2_tbclk@44e10664 {
  #clock-cells = <0>;
  compatible = "ti,gate-clock";
  clocks = <&l4ls_gclk>;
  ti,bit-shift = <2>;
  reg = <0x0664>;
 };
};
&prcm_clocks {
 clk_32768_ck: clk_32768_ck {
  #clock-cells = <0>;
  compatible = "fixed-clock";
  clock-frequency = <32768>;
 };

 clk_rc32k_ck: clk_rc32k_ck {
  #clock-cells = <0>;
  compatible = "fixed-clock";
  clock-frequency = <32000>;
 };

 virt_19200000_ck: virt_19200000_ck {
  #clock-cells = <0>;
  compatible = "fixed-clock";
  clock-frequency = <19200000>;
 };

 virt_24000000_ck: virt_24000000_ck {
  #clock-cells = <0>;
  compatible = "fixed-clock";
  clock-frequency = <24000000>;
 };

 virt_25000000_ck: virt_25000000_ck {
  #clock-cells = <0>;
  compatible = "fixed-clock";
  clock-frequency = <25000000>;
 };

 virt_26000000_ck: virt_26000000_ck {
  #clock-cells = <0>;
  compatible = "fixed-clock";
  clock-frequency = <26000000>;
 };

 tclkin_ck: tclkin_ck {
  #clock-cells = <0>;
  compatible = "fixed-clock";
  clock-frequency = <12000000>;
 };

 dpll_core_ck: dpll_core_ck@490 {
  #clock-cells = <0>;
  compatible = "ti,am3-dpll-core-clock";
  clocks = <&sys_clkin_ck>, <&sys_clkin_ck>;
  reg = <0x0490>, <0x045c>, <0x0468>;
 };

 dpll_core_x2_ck: dpll_core_x2_ck {
  #clock-cells = <0>;
  compatible = "ti,am3-dpll-x2-clock";
  clocks = <&dpll_core_ck>;
 };

 dpll_core_m4_ck: dpll_core_m4_ck@480 {
  #clock-cells = <0>;
  compatible = "ti,divider-clock";
  clocks = <&dpll_core_x2_ck>;
  ti,max-div = <31>;
  reg = <0x0480>;
  ti,index-starts-at-one;
 };

 dpll_core_m5_ck: dpll_core_m5_ck@484 {
  #clock-cells = <0>;
  compatible = "ti,divider-clock";
  clocks = <&dpll_core_x2_ck>;
  ti,max-div = <31>;
  reg = <0x0484>;
  ti,index-starts-at-one;
 };

 dpll_core_m6_ck: dpll_core_m6_ck@4d8 {
  #clock-cells = <0>;
  compatible = "ti,divider-clock";
  clocks = <&dpll_core_x2_ck>;
  ti,max-div = <31>;
  reg = <0x04d8>;
  ti,index-starts-at-one;
 };

 dpll_mpu_ck: dpll_mpu_ck@488 {
  #clock-cells = <0>;
  compatible = "ti,am3-dpll-clock";
  clocks = <&sys_clkin_ck>, <&sys_clkin_ck>;
  reg = <0x0488>, <0x0420>, <0x042c>;
 };

 dpll_mpu_m2_ck: dpll_mpu_m2_ck@4a8 {
  #clock-cells = <0>;
  compatible = "ti,divider-clock";
  clocks = <&dpll_mpu_ck>;
  ti,max-div = <31>;
  reg = <0x04a8>;
  ti,index-starts-at-one;
 };

 dpll_ddr_ck: dpll_ddr_ck@494 {
  #clock-cells = <0>;
  compatible = "ti,am3-dpll-no-gate-clock";
  clocks = <&sys_clkin_ck>, <&sys_clkin_ck>;
  reg = <0x0494>, <0x0434>, <0x0440>;
 };

 dpll_ddr_m2_ck: dpll_ddr_m2_ck@4a0 {
  #clock-cells = <0>;
  compatible = "ti,divider-clock";
  clocks = <&dpll_ddr_ck>;
  ti,max-div = <31>;
  reg = <0x04a0>;
  ti,index-starts-at-one;
 };

 dpll_ddr_m2_div2_ck: dpll_ddr_m2_div2_ck {
  #clock-cells = <0>;
  compatible = "fixed-factor-clock";
  clocks = <&dpll_ddr_m2_ck>;
  clock-mult = <1>;
  clock-div = <2>;
 };

 dpll_disp_ck: dpll_disp_ck@498 {
  #clock-cells = <0>;
  compatible = "ti,am3-dpll-no-gate-clock";
  clocks = <&sys_clkin_ck>, <&sys_clkin_ck>;
  reg = <0x0498>, <0x0448>, <0x0454>;
 };

 dpll_disp_m2_ck: dpll_disp_m2_ck@4a4 {
  #clock-cells = <0>;
  compatible = "ti,divider-clock";
  clocks = <&dpll_disp_ck>;
  ti,max-div = <31>;
  reg = <0x04a4>;
  ti,index-starts-at-one;
  ti,set-rate-parent;
 };

 dpll_per_ck: dpll_per_ck@48c {
  #clock-cells = <0>;
  compatible = "ti,am3-dpll-no-gate-j-type-clock";
  clocks = <&sys_clkin_ck>, <&sys_clkin_ck>;
  reg = <0x048c>, <0x0470>, <0x049c>;
 };

 dpll_per_m2_ck: dpll_per_m2_ck@4ac {
  #clock-cells = <0>;
  compatible = "ti,divider-clock";
  clocks = <&dpll_per_ck>;
  ti,max-div = <31>;
  reg = <0x04ac>;
  ti,index-starts-at-one;
 };

 dpll_per_m2_div4_wkupdm_ck: dpll_per_m2_div4_wkupdm_ck {
  #clock-cells = <0>;
  compatible = "fixed-factor-clock";
  clocks = <&dpll_per_m2_ck>;
  clock-mult = <1>;
  clock-div = <4>;
 };

 dpll_per_m2_div4_ck: dpll_per_m2_div4_ck {
  #clock-cells = <0>;
  compatible = "fixed-factor-clock";
  clocks = <&dpll_per_m2_ck>;
  clock-mult = <1>;
  clock-div = <4>;
 };

 clk_24mhz: clk_24mhz {
  #clock-cells = <0>;
  compatible = "fixed-factor-clock";
  clocks = <&dpll_per_m2_ck>;
  clock-mult = <1>;
  clock-div = <8>;
 };

 clkdiv32k_ck: clkdiv32k_ck {
  #clock-cells = <0>;
  compatible = "fixed-factor-clock";
  clocks = <&clk_24mhz>;
  clock-mult = <1>;
  clock-div = <732>;
 };

 l3_gclk: l3_gclk {
  #clock-cells = <0>;
  compatible = "fixed-factor-clock";
  clocks = <&dpll_core_m4_ck>;
  clock-mult = <1>;
  clock-div = <1>;
 };

 pruss_ocp_gclk: pruss_ocp_gclk@530 {
  #clock-cells = <0>;
  compatible = "ti,mux-clock";
  clocks = <&l3_gclk>, <&dpll_disp_m2_ck>;
  reg = <0x0530>;
 };

 mmu_fck: mmu_fck@914 {
  #clock-cells = <0>;
  compatible = "ti,gate-clock";
  clocks = <&dpll_core_m4_ck>;
  ti,bit-shift = <1>;
  reg = <0x0914>;
 };

 timer1_fck: timer1_fck@528 {
  #clock-cells = <0>;
  compatible = "ti,mux-clock";
  clocks = <&sys_clkin_ck>, <&l4_per_clkctrl ((0x14c) - 0x14) 0>, <&tclkin_ck>, <&clk_rc32k_ck>, <&clk_32768_ck>;
  reg = <0x0528>;
 };

 timer2_fck: timer2_fck@508 {
  #clock-cells = <0>;
  compatible = "ti,mux-clock";
  clocks = <&tclkin_ck>, <&sys_clkin_ck>, <&l4_per_clkctrl ((0x14c) - 0x14) 0>;
  reg = <0x0508>;
 };

 timer3_fck: timer3_fck@50c {
  #clock-cells = <0>;
  compatible = "ti,mux-clock";
  clocks = <&tclkin_ck>, <&sys_clkin_ck>, <&l4_per_clkctrl ((0x14c) - 0x14) 0>;
  reg = <0x050c>;
 };

 timer4_fck: timer4_fck@510 {
  #clock-cells = <0>;
  compatible = "ti,mux-clock";
  clocks = <&tclkin_ck>, <&sys_clkin_ck>, <&l4_per_clkctrl ((0x14c) - 0x14) 0>;
  reg = <0x0510>;
 };

 timer5_fck: timer5_fck@518 {
  #clock-cells = <0>;
  compatible = "ti,mux-clock";
  clocks = <&tclkin_ck>, <&sys_clkin_ck>, <&l4_per_clkctrl ((0x14c) - 0x14) 0>;
  reg = <0x0518>;
 };

 timer6_fck: timer6_fck@51c {
  #clock-cells = <0>;
  compatible = "ti,mux-clock";
  clocks = <&tclkin_ck>, <&sys_clkin_ck>, <&l4_per_clkctrl ((0x14c) - 0x14) 0>;
  reg = <0x051c>;
 };

 timer7_fck: timer7_fck@504 {
  #clock-cells = <0>;
  compatible = "ti,mux-clock";
  clocks = <&tclkin_ck>, <&sys_clkin_ck>, <&l4_per_clkctrl ((0x14c) - 0x14) 0>;
  reg = <0x0504>;
 };

 usbotg_fck: usbotg_fck@47c {
  #clock-cells = <0>;
  compatible = "ti,gate-clock";
  clocks = <&dpll_per_ck>;
  ti,bit-shift = <8>;
  reg = <0x047c>;
 };

 dpll_core_m4_div2_ck: dpll_core_m4_div2_ck {
  #clock-cells = <0>;
  compatible = "fixed-factor-clock";
  clocks = <&dpll_core_m4_ck>;
  clock-mult = <1>;
  clock-div = <2>;
 };

 ieee5000_fck: ieee5000_fck@e4 {
  #clock-cells = <0>;
  compatible = "ti,gate-clock";
  clocks = <&dpll_core_m4_div2_ck>;
  ti,bit-shift = <1>;
  reg = <0x00e4>;
 };

 wdt1_fck: wdt1_fck@538 {
  #clock-cells = <0>;
  compatible = "ti,mux-clock";
  clocks = <&clk_rc32k_ck>, <&l4_per_clkctrl ((0x14c) - 0x14) 0>;
  reg = <0x0538>;
 };

 l4_rtc_gclk: l4_rtc_gclk {
  #clock-cells = <0>;
  compatible = "fixed-factor-clock";
  clocks = <&dpll_core_m4_ck>;
  clock-mult = <1>;
  clock-div = <2>;
 };

 l4hs_gclk: l4hs_gclk {
  #clock-cells = <0>;
  compatible = "fixed-factor-clock";
  clocks = <&dpll_core_m4_ck>;
  clock-mult = <1>;
  clock-div = <1>;
 };

 l3s_gclk: l3s_gclk {
  #clock-cells = <0>;
  compatible = "fixed-factor-clock";
  clocks = <&dpll_core_m4_div2_ck>;
  clock-mult = <1>;
  clock-div = <1>;
 };

 l4fw_gclk: l4fw_gclk {
  #clock-cells = <0>;
  compatible = "fixed-factor-clock";
  clocks = <&dpll_core_m4_div2_ck>;
  clock-mult = <1>;
  clock-div = <1>;
 };

 l4ls_gclk: l4ls_gclk {
  #clock-cells = <0>;
  compatible = "fixed-factor-clock";
  clocks = <&dpll_core_m4_div2_ck>;
  clock-mult = <1>;
  clock-div = <1>;
 };

 sysclk_div_ck: sysclk_div_ck {
  #clock-cells = <0>;
  compatible = "fixed-factor-clock";
  clocks = <&dpll_core_m4_ck>;
  clock-mult = <1>;
  clock-div = <1>;
 };

 cpsw_125mhz_gclk: cpsw_125mhz_gclk {
  #clock-cells = <0>;
  compatible = "fixed-factor-clock";
  clocks = <&dpll_core_m5_ck>;
  clock-mult = <1>;
  clock-div = <2>;
 };

 cpsw_cpts_rft_clk: cpsw_cpts_rft_clk@520 {
  #clock-cells = <0>;
  compatible = "ti,mux-clock";
  clocks = <&dpll_core_m5_ck>, <&dpll_core_m4_ck>;
  reg = <0x0520>;
 };

 gpio0_dbclk_mux_ck: gpio0_dbclk_mux_ck@53c {
  #clock-cells = <0>;
  compatible = "ti,mux-clock";
  clocks = <&clk_rc32k_ck>, <&clk_32768_ck>, <&l4_per_clkctrl ((0x14c) - 0x14) 0>;
  reg = <0x053c>;
 };

 lcd_gclk: lcd_gclk@534 {
  #clock-cells = <0>;
  compatible = "ti,mux-clock";
  clocks = <&dpll_disp_m2_ck>, <&dpll_core_m5_ck>, <&dpll_per_m2_ck>;
  reg = <0x0534>;
  ti,set-rate-parent;
 };

 mmc_clk: mmc_clk {
  #clock-cells = <0>;
  compatible = "fixed-factor-clock";
  clocks = <&dpll_per_m2_ck>;
  clock-mult = <1>;
  clock-div = <2>;
 };

 gfx_fclk_clksel_ck: gfx_fclk_clksel_ck@52c {
  #clock-cells = <0>;
  compatible = "ti,mux-clock";
  clocks = <&dpll_core_m4_ck>, <&dpll_per_m2_ck>;
  ti,bit-shift = <1>;
  reg = <0x052c>;
 };

 gfx_fck_div_ck: gfx_fck_div_ck@52c {
  #clock-cells = <0>;
  compatible = "ti,divider-clock";
  clocks = <&gfx_fclk_clksel_ck>;
  reg = <0x052c>;
  ti,max-div = <2>;
 };

 sysclkout_pre_ck: sysclkout_pre_ck@700 {
  #clock-cells = <0>;
  compatible = "ti,mux-clock";
  clocks = <&clk_32768_ck>, <&l3_gclk>, <&dpll_ddr_m2_ck>, <&dpll_per_m2_ck>, <&lcd_gclk>;
  reg = <0x0700>;
 };

 clkout2_div_ck: clkout2_div_ck@700 {
  #clock-cells = <0>;
  compatible = "ti,divider-clock";
  clocks = <&sysclkout_pre_ck>;
  ti,bit-shift = <3>;
  ti,max-div = <8>;
  reg = <0x0700>;
 };

 clkout2_ck: clkout2_ck@700 {
  #clock-cells = <0>;
  compatible = "ti,gate-clock";
  clocks = <&clkout2_div_ck>;
  ti,bit-shift = <7>;
  reg = <0x0700>;
 };
};

&prcm {
 l4_per_cm: l4_per_cm@0 {
  compatible = "ti,omap4-cm";
  reg = <0x0 0x200>;
  #address-cells = <1>;
  #size-cells = <1>;
  ranges = <0 0x0 0x200>;

  l4_per_clkctrl: clk@14 {
   compatible = "ti,clkctrl";
   reg = <0x14 0x13c>;
   #clock-cells = <2>;
  };
 };

 l4_wkup_cm: l4_wkup_cm@400 {
  compatible = "ti,omap4-cm";
  reg = <0x400 0x100>;
  #address-cells = <1>;
  #size-cells = <1>;
  ranges = <0 0x400 0x100>;

  l4_wkup_clkctrl: clk@4 {
   compatible = "ti,clkctrl";
   reg = <0x4 0xd4>;
   #clock-cells = <2>;
  };
 };

 mpu_cm: mpu_cm@600 {
  compatible = "ti,omap4-cm";
  reg = <0x600 0x100>;
  #address-cells = <1>;
  #size-cells = <1>;
  ranges = <0 0x600 0x100>;

  mpu_clkctrl: clk@4 {
   compatible = "ti,clkctrl";
   reg = <0x4 0x4>;
   #clock-cells = <2>;
  };
 };

 l4_rtc_cm: l4_rtc_cm@800 {
  compatible = "ti,omap4-cm";
  reg = <0x800 0x100>;
  #address-cells = <1>;
  #size-cells = <1>;
  ranges = <0 0x800 0x100>;

  l4_rtc_clkctrl: clk@0 {
   compatible = "ti,clkctrl";
   reg = <0x0 0x4>;
   #clock-cells = <2>;
  };
 };

 gfx_l3_cm: gfx_l3_cm@900 {
  compatible = "ti,omap4-cm";
  reg = <0x900 0x100>;
  #address-cells = <1>;
  #size-cells = <1>;
  ranges = <0 0x900 0x100>;

  gfx_l3_clkctrl: clk@4 {
   compatible = "ti,clkctrl";
   reg = <0x4 0x4>;
   #clock-cells = <2>;
  };
 };

 l4_cefuse_cm: l4_cefuse_cm@a00 {
  compatible = "ti,omap4-cm";
  reg = <0xa00 0x100>;
  #address-cells = <1>;
  #size-cells = <1>;
  ranges = <0 0xa00 0x100>;

  l4_cefuse_clkctrl: clk@20 {
   compatible = "ti,clkctrl";
   reg = <0x20 0x4>;
   #clock-cells = <2>;
  };
 };
};
# 1318 "./src/arm/am33xx.dtsi" 2
# 8 "./src/arm/am335x-boneblack.dts" 2
# 1 "./src/arm/am335x-bone-common.dtsi" 1





/ {
 cpus {
  cpu@0 {
   cpu0-supply = <&dcdc2_reg>;
  };
 };

 memory@80000000 {
  device_type = "memory";
  reg = <0x80000000 0x10000000>;
 };

 chosen {
  stdout-path = &uart0;
 };

 leds {
  pinctrl-names = "default";
  pinctrl-0 = <&user_leds_s0>;

  compatible = "gpio-leds";

  led2 {
   label = "beaglebone:green:usr0";
   gpios = <&gpio1 21 0>;
   linux,default-trigger = "heartbeat";
   default-state = "off";
  };

  led3 {
   label = "beaglebone:green:usr1";
   gpios = <&gpio1 22 0>;
   linux,default-trigger = "mmc0";
   default-state = "off";
  };

  led4 {
   label = "beaglebone:green:usr2";
   gpios = <&gpio1 23 0>;
   linux,default-trigger = "cpu0";
   default-state = "off";
  };

  led5 {
   label = "beaglebone:green:usr3";
   gpios = <&gpio1 24 0>;
   linux,default-trigger = "mmc1";
   default-state = "off";
  };

  led6 {
   label = "beaglebone:green:usr4";
   gpios = <&gpio1 18 0>;
   linux,default-trigger = "heartbeat";
   default-state = "off";
  };
 };

 vmmcsd_fixed: fixedregulator0 {
  compatible = "regulator-fixed";
  regulator-name = "vmmcsd_fixed";
  regulator-min-microvolt = <3300000>;
  regulator-max-microvolt = <3300000>;
 };
};

&am33xx_pinmux {
 user_leds_s0: user_leds_s0 {
  pinctrl-single,pins = <
   ((((0x854)) & 0xffff) - (0x0800)) ((0) | (7))
   ((((0x858)) & 0xffff) - (0x0800)) ((((1 << 4))) | (7))
   ((((0x85c)) & 0xffff) - (0x0800)) ((0) | (7))
   ((((0x860)) & 0xffff) - (0x0800)) ((((1 << 4))) | (7))
  >;
 };

 i2c0_pins: pinmux_i2c0_pins {
  pinctrl-single,pins = <
   ((((0x988)) & 0xffff) - (0x0800)) ((((1 << 5) | (1 << 4))) | (0))
   ((((0x98c)) & 0xffff) - (0x0800)) ((((1 << 5) | (1 << 4))) | (0))
  >;
 };
# 89 "./src/arm/am335x-bone-common.dtsi"
 uart0_pins: pinmux_uart0_pins {
  pinctrl-single,pins = <
   ((((0x970)) & 0xffff) - (0x0800)) ((((1 << 5) | (1 << 4))) | (0))
   ((((0x974)) & 0xffff) - (0x0800)) ((0) | (0))
  >;
 };

 cpsw_default: cpsw_default {
  pinctrl-single,pins = <

   ((((0x910)) & 0xffff) - (0x0800)) ((((1 << 5) | (1 << 4))) | (0))
   ((((0x914)) & 0xffff) - (0x0800)) ((0) | (0))
   ((((0x918)) & 0xffff) - (0x0800)) ((((1 << 5) | (1 << 4))) | (0))
   ((((0x91c)) & 0xffff) - (0x0800)) ((0) | (0))
   ((((0x920)) & 0xffff) - (0x0800)) ((0) | (0))
   ((((0x924)) & 0xffff) - (0x0800)) ((0) | (0))
   ((((0x928)) & 0xffff) - (0x0800)) ((0) | (0))
   ((((0x92c)) & 0xffff) - (0x0800)) ((((1 << 5) | (1 << 4))) | (0))
   ((((0x930)) & 0xffff) - (0x0800)) ((((1 << 5) | (1 << 4))) | (0))
   ((((0x934)) & 0xffff) - (0x0800)) ((((1 << 5) | (1 << 4))) | (0))
   ((((0x938)) & 0xffff) - (0x0800)) ((((1 << 5) | (1 << 4))) | (0))
   ((((0x93c)) & 0xffff) - (0x0800)) ((((1 << 5) | (1 << 4))) | (0))
   ((((0x940)) & 0xffff) - (0x0800)) ((((1 << 5) | (1 << 4))) | (0))
  >;
 };

 cpsw_sleep: cpsw_sleep {
  pinctrl-single,pins = <

   ((((0x910)) & 0xffff) - (0x0800)) ((((1 << 5))) | (7))
   ((((0x914)) & 0xffff) - (0x0800)) ((((1 << 5))) | (7))
   ((((0x918)) & 0xffff) - (0x0800)) ((((1 << 5))) | (7))
   ((((0x91c)) & 0xffff) - (0x0800)) ((((1 << 5))) | (7))
   ((((0x920)) & 0xffff) - (0x0800)) ((((1 << 5))) | (7))
   ((((0x924)) & 0xffff) - (0x0800)) ((((1 << 5))) | (7))
   ((((0x928)) & 0xffff) - (0x0800)) ((((1 << 5))) | (7))
   ((((0x92c)) & 0xffff) - (0x0800)) ((((1 << 5))) | (7))
   ((((0x930)) & 0xffff) - (0x0800)) ((((1 << 5))) | (7))
   ((((0x934)) & 0xffff) - (0x0800)) ((((1 << 5))) | (7))
   ((((0x938)) & 0xffff) - (0x0800)) ((((1 << 5))) | (7))
   ((((0x93c)) & 0xffff) - (0x0800)) ((((1 << 5))) | (7))
   ((((0x940)) & 0xffff) - (0x0800)) ((((1 << 5))) | (7))
  >;
 };

 davinci_mdio_default: davinci_mdio_default {
  pinctrl-single,pins = <

   ((((0x948)) & 0xffff) - (0x0800)) ((((1 << 5) | (1 << 4)) | 0) | (0))
   ((((0x94c)) & 0xffff) - (0x0800)) ((((1 << 4))) | (0))
  >;
 };

 davinci_mdio_sleep: davinci_mdio_sleep {
  pinctrl-single,pins = <

   ((((0x948)) & 0xffff) - (0x0800)) ((((1 << 5))) | (7))
   ((((0x94c)) & 0xffff) - (0x0800)) ((((1 << 5))) | (7))
  >;
 };

 mmc1_pins: pinmux_mmc1_pins {
  pinctrl-single,pins = <
   ((((0x960)) & 0xffff) - (0x0800)) ((((1 << 5) | (1 << 3))) | (7))
   ((((0x8fc)) & 0xffff) - (0x0800)) ((((1 << 5) | (1 << 4))) | (0))
   ((((0x8f8)) & 0xffff) - (0x0800)) ((((1 << 5) | (1 << 4))) | (0))
   ((((0x8f4)) & 0xffff) - (0x0800)) ((((1 << 5) | (1 << 4))) | (0))
   ((((0x8f0)) & 0xffff) - (0x0800)) ((((1 << 5) | (1 << 4))) | (0))
   ((((0x904)) & 0xffff) - (0x0800)) ((((1 << 5) | (1 << 4))) | (0))
   ((((0x900)) & 0xffff) - (0x0800)) ((((1 << 5) | (1 << 4))) | (0))
  >;
 };

 emmc_pins: pinmux_emmc_pins {
  pinctrl-single,pins = <
   ((((0x880)) & 0xffff) - (0x0800)) ((((1 << 5) | (1 << 4))) | (2))
   ((((0x884)) & 0xffff) - (0x0800)) ((((1 << 5) | (1 << 4))) | (2))
   ((((0x800)) & 0xffff) - (0x0800)) ((((1 << 5) | (1 << 4))) | (1))
   ((((0x804)) & 0xffff) - (0x0800)) ((((1 << 5) | (1 << 4))) | (1))
   ((((0x808)) & 0xffff) - (0x0800)) ((((1 << 5) | (1 << 4))) | (1))
   ((((0x80c)) & 0xffff) - (0x0800)) ((((1 << 5) | (1 << 4))) | (1))
   ((((0x810)) & 0xffff) - (0x0800)) ((((1 << 5) | (1 << 4))) | (1))
   ((((0x814)) & 0xffff) - (0x0800)) ((((1 << 5) | (1 << 4))) | (1))
   ((((0x818)) & 0xffff) - (0x0800)) ((((1 << 5) | (1 << 4))) | (1))
   ((((0x81c)) & 0xffff) - (0x0800)) ((((1 << 5) | (1 << 4))) | (1))
  >;
 };


 P9_19_default_pin: pinmux_P9_19_default_pin { pinctrl-single,pins = <
  ((((0x097c)) & 0xffff) - (0x0800)) (((1 << 5) | (1 << 4)) | 3) >; };
 P9_19_gpio_pin: pinmux_P9_19_gpio_pin { pinctrl-single,pins = <
  ((((0x097c)) & 0xffff) - (0x0800)) (((1 << 3)) | (1 << 5) | 7) >; };
 P9_19_gpio_pu_pin: pinmux_P9_19_gpio_pu_pin { pinctrl-single,pins = <
  ((((0x097c)) & 0xffff) - (0x0800)) (((1 << 4)) | (1 << 5) | 7) >; };
 P9_19_gpio_pd_pin: pinmux_P9_19_gpio_pd_pin { pinctrl-single,pins = <
  ((((0x097c)) & 0xffff) - (0x0800)) (0 | (1 << 5) | 7) >; };
 P9_19_gpio_input_pin: pinmux_P9_19_gpio_input_pin { pinctrl-single,pins = <
  ((((0x097c)) & 0xffff) - (0x0800)) (((1 << 5) | (1 << 3)) | 7) >; };
 P9_19_timer_pin: pinmux_P9_19_timer_pin { pinctrl-single,pins = <
  ((((0x097c)) & 0xffff) - (0x0800)) (((1 << 4)) | (1 << 5) | 1) >; };
 P9_19_can_pin: pinmux_P9_19_can_pin { pinctrl-single,pins = <
  ((((0x097c)) & 0xffff) - (0x0800)) (((1 << 5) | (1 << 4)) | 2) >; };
 P9_19_i2c_pin: pinmux_P9_19_i2c_pin { pinctrl-single,pins = <
  ((((0x097c)) & 0xffff) - (0x0800)) (((1 << 5) | (1 << 4)) | 3) >; };
 P9_19_spi_cs_pin: pinmux_P9_19_spi_cs_pin { pinctrl-single,pins = <
  ((((0x097c)) & 0xffff) - (0x0800)) (((1 << 4)) | (1 << 5) | 4) >; };
 P9_19_pru_uart_pin: pinmux_P9_19_pru_uart_pin { pinctrl-single,pins = <
  ((((0x097c)) & 0xffff) - (0x0800)) (((1 << 4)) | (1 << 5) | 5) >; };


 P9_20_default_pin: pinmux_P9_20_default_pin { pinctrl-single,pins = <
  ((((0x0978)) & 0xffff) - (0x0800)) (((1 << 5) | (1 << 4)) | 3) >; };
 P9_20_gpio_pin: pinmux_P9_20_gpio_pin { pinctrl-single,pins = <
  ((((0x0978)) & 0xffff) - (0x0800)) (((1 << 3)) | (1 << 5) | 7) >; };
 P9_20_gpio_pu_pin: pinmux_P9_20_gpio_pu_pin { pinctrl-single,pins = <
  ((((0x0978)) & 0xffff) - (0x0800)) (((1 << 4)) | (1 << 5) | 7) >; };
 P9_20_gpio_pd_pin: pinmux_P9_20_gpio_pd_pin { pinctrl-single,pins = <
  ((((0x0978)) & 0xffff) - (0x0800)) (0 | (1 << 5) | 7) >; };
 P9_20_gpio_input_pin: pinmux_P9_20_gpio_input_pin { pinctrl-single,pins = <
  ((((0x0978)) & 0xffff) - (0x0800)) (((1 << 5) | (1 << 3)) | 7) >; };
 P9_20_timer_pin: pinmux_P9_20_timer_pin { pinctrl-single,pins = <
  ((((0x0978)) & 0xffff) - (0x0800)) (((1 << 4)) | (1 << 5) | 1) >; };
 P9_20_can_pin: pinmux_P9_20_can_pin { pinctrl-single,pins = <
  ((((0x0978)) & 0xffff) - (0x0800)) (((1 << 4)) | 2) >; };
 P9_20_i2c_pin: pinmux_P9_20_i2c_pin { pinctrl-single,pins = <
  ((((0x0978)) & 0xffff) - (0x0800)) (((1 << 5) | (1 << 4)) | 3) >; };
 P9_20_spi_cs_pin: pinmux_P9_20_spi_cs_pin { pinctrl-single,pins = <
  ((((0x0978)) & 0xffff) - (0x0800)) (((1 << 4)) | (1 << 5) | 4) >; };
 P9_20_pru_uart_pin: pinmux_P9_20_pru_uart_pin { pinctrl-single,pins = <
  ((((0x0978)) & 0xffff) - (0x0800)) (((1 << 4)) | (1 << 5) | 5) >; };
};

&uart0 {
 pinctrl-names = "default";
 pinctrl-0 = <&uart0_pins>;

 status = "okay";
};

&usb {
 status = "okay";
};

&usb_ctrl_mod {
 status = "okay";
};

&usb0_phy {
 status = "okay";
};

&usb1_phy {
 status = "okay";
};

&usb0 {
 status = "okay";
 dr_mode = "peripheral";
 interrupts-extended = <&intc 18 &tps 0>;
 interrupt-names = "mc", "vbus";
};

&usb1 {
 status = "okay";
 dr_mode = "host";
};

&cppi41dma {
 status = "okay";
};

&i2c0 {
 pinctrl-names = "default";
 pinctrl-0 = <&i2c0_pins>;

 status = "okay";
 clock-frequency = <400000>;

 tps: tps@24 {
  reg = <0x24>;
 };

 baseboard_eeprom: baseboard_eeprom@50 {
  compatible = "atmel,24c256";
  reg = <0x50>;

  #address-cells = <1>;
  #size-cells = <1>;
  baseboard_data: baseboard_data@0 {
   reg = <0 0x100>;
  };
 };
};

&i2c2 {
 pinctrl-names = "default";

 pinctrl-0 = <>;

 status = "okay";
 clock-frequency = <100000>;

 cape_eeprom0: cape_eeprom0@54 {
  compatible = "atmel,24c256";
  reg = <0x54>;
  #address-cells = <1>;
  #size-cells = <1>;
  cape0_data: cape_data@0 {
   reg = <0 0x100>;
  };
 };

 cape_eeprom1: cape_eeprom1@55 {
  compatible = "atmel,24c256";
  reg = <0x55>;
  #address-cells = <1>;
  #size-cells = <1>;
  cape1_data: cape_data@0 {
   reg = <0 0x100>;
  };
 };

 cape_eeprom2: cape_eeprom2@56 {
  compatible = "atmel,24c256";
  reg = <0x56>;
  #address-cells = <1>;
  #size-cells = <1>;
  cape2_data: cape_data@0 {
   reg = <0 0x100>;
  };
 };

 cape_eeprom3: cape_eeprom3@57 {
  compatible = "atmel,24c256";
  reg = <0x57>;
  #address-cells = <1>;
  #size-cells = <1>;
  cape3_data: cape_data@0 {
   reg = <0 0x100>;
  };
 };
};


/include/ "tps65217.dtsi"

&tps {
# 355 "./src/arm/am335x-bone-common.dtsi"
 interrupts = <7>;
 interrupt-parent = <&intc>;

 ti,pmic-shutdown-controller;

 charger {
  status = "okay";
 };

 pwrbutton {
  status = "okay";
 };

 regulators {
  dcdc1_reg: regulator@0 {
   regulator-name = "vdds_dpr";
   regulator-always-on;
  };

  dcdc2_reg: regulator@1 {

   regulator-name = "vdd_mpu";
   regulator-min-microvolt = <925000>;
   regulator-max-microvolt = <1351500>;
   regulator-boot-on;
   regulator-always-on;
  };

  dcdc3_reg: regulator@2 {

   regulator-name = "vdd_core";
   regulator-min-microvolt = <925000>;
   regulator-max-microvolt = <1150000>;
   regulator-boot-on;
   regulator-always-on;
  };

  ldo1_reg: regulator@3 {
   regulator-name = "vio,vrtc,vdds";
   regulator-always-on;
  };

  ldo2_reg: regulator@4 {
   regulator-name = "vdd_3v3aux";
   regulator-always-on;
  };

  ldo3_reg: regulator@5 {
   regulator-name = "vdd_1v8";
   regulator-always-on;
  };

  ldo4_reg: regulator@6 {
   regulator-name = "vdd_3v3a";
   regulator-always-on;
  };
 };
};

&cpsw_emac0 {
 phy_id = <&davinci_mdio>, <0>;
 phy-mode = "mii";
};

&mac {
 slaves = <1>;
 pinctrl-names = "default", "sleep";
 pinctrl-0 = <&cpsw_default>;
 pinctrl-1 = <&cpsw_sleep>;
 status = "okay";
};

&davinci_mdio {
 pinctrl-names = "default", "sleep";
 pinctrl-0 = <&davinci_mdio_default>;
 pinctrl-1 = <&davinci_mdio_sleep>;
 status = "okay";
};

&mmc1 {
 status = "okay";
 bus-width = <0x4>;
 pinctrl-names = "default";
 pinctrl-0 = <&mmc1_pins>;
 cd-gpios = <&gpio0 6 1>;
};

&aes {
 status = "okay";
};

&sham {
 status = "okay";
};

&rtc {
 clocks = <&clk_32768_ck>, <&l4_per_clkctrl ((0x14c) - 0x14) 0>;
 clock-names = "ext-clk", "int-clk";
 system-power-controller;
};

&wkup_m3_ipc {
 ti,scale-data-fw = "am335x-bone-scale-data.bin";
};
# 468 "./src/arm/am335x-bone-common.dtsi"
&ocp {

 P9_19_pinmux {
  compatible = "bone-pinmux-helper";
  status = "okay";
  pinctrl-names = "default", "gpio", "gpio_pu", "gpio_pd", "gpio_input", "spi_cs", "can", "i2c", "pru_uart", "timer";
  pinctrl-0 = <&P9_19_default_pin>;
  pinctrl-1 = <&P9_19_gpio_pin>;
  pinctrl-2 = <&P9_19_gpio_pu_pin>;
  pinctrl-3 = <&P9_19_gpio_pd_pin>;
  pinctrl-4 = <&P9_19_gpio_input_pin>;
  pinctrl-5 = <&P9_19_spi_cs_pin>;
  pinctrl-6 = <&P9_19_can_pin>;
  pinctrl-7 = <&P9_19_i2c_pin>;
  pinctrl-8 = <&P9_19_pru_uart_pin>;
  pinctrl-9 = <&P9_19_timer_pin>;
 };


 P9_20_pinmux {
  compatible = "bone-pinmux-helper";
  status = "okay";
  pinctrl-names = "default", "gpio", "gpio_pu", "gpio_pd", "gpio_input", "spi_cs", "can", "i2c", "pru_uart", "timer";
  pinctrl-0 = <&P9_20_default_pin>;
  pinctrl-1 = <&P9_20_gpio_pin>;
  pinctrl-2 = <&P9_20_gpio_pu_pin>;
  pinctrl-3 = <&P9_20_gpio_pd_pin>;
  pinctrl-4 = <&P9_20_gpio_input_pin>;
  pinctrl-5 = <&P9_20_spi_cs_pin>;
  pinctrl-6 = <&P9_20_can_pin>;
  pinctrl-7 = <&P9_20_i2c_pin>;
  pinctrl-8 = <&P9_20_pru_uart_pin>;
  pinctrl-9 = <&P9_20_timer_pin>;
 };


 cape-universal {
  compatible = "gpio-of-helper";
  status = "okay";
  pinctrl-names = "default";
  pinctrl-0 = <>;

  P9_19 {
   gpio-name = "P9_19";
   gpio = <&gpio0 13 0>;
   input;
   dir-changeable;
  };

  P9_20 {
   gpio-name = "P9_20";
   gpio = <&gpio0 12 0>;
   input;
   dir-changeable;
  };

 };
};
# 9 "./src/arm/am335x-boneblack.dts" 2
# 1 "./src/arm/am335x-boneblack-common.dtsi" 1





# 1 "./include/dt-bindings/display/tda998x.h" 1
# 7 "./src/arm/am335x-boneblack-common.dtsi" 2

&ldo3_reg {
 regulator-min-microvolt = <1800000>;
 regulator-max-microvolt = <1800000>;
 regulator-always-on;
};

&mmc1 {
 vmmc-supply = <&vmmcsd_fixed>;
};

&mmc2 {
 vmmc-supply = <&vmmcsd_fixed>;
 pinctrl-names = "default";
 pinctrl-0 = <&emmc_pins>;
 bus-width = <8>;
 status = "okay";
};

&am33xx_pinmux {
 nxp_hdmi_bonelt_pins: nxp_hdmi_bonelt_pins {
  pinctrl-single,pins = <
   ((((0x8a0)) & 0xffff) - (0x0800)) ((((1 << 3))) | (0))
   ((((0x8a4)) & 0xffff) - (0x0800)) ((((1 << 3))) | (0))
   ((((0x8a8)) & 0xffff) - (0x0800)) ((((1 << 3))) | (0))
   ((((0x8ac)) & 0xffff) - (0x0800)) ((((1 << 3))) | (0))
   ((((0x8b0)) & 0xffff) - (0x0800)) ((((1 << 3))) | (0))
   ((((0x8b4)) & 0xffff) - (0x0800)) ((((1 << 3))) | (0))
   ((((0x8b8)) & 0xffff) - (0x0800)) ((((1 << 3))) | (0))
   ((((0x8bc)) & 0xffff) - (0x0800)) ((((1 << 3))) | (0))
   ((((0x8c0)) & 0xffff) - (0x0800)) ((((1 << 3))) | (0))
   ((((0x8c4)) & 0xffff) - (0x0800)) ((((1 << 3))) | (0))
   ((((0x8c8)) & 0xffff) - (0x0800)) ((((1 << 3))) | (0))
   ((((0x8cc)) & 0xffff) - (0x0800)) ((((1 << 3))) | (0))
   ((((0x8d0)) & 0xffff) - (0x0800)) ((((1 << 3))) | (0))
   ((((0x8d4)) & 0xffff) - (0x0800)) ((((1 << 3))) | (0))
   ((((0x8d8)) & 0xffff) - (0x0800)) ((((1 << 3))) | (0))
   ((((0x8dc)) & 0xffff) - (0x0800)) ((((1 << 3))) | (0))
   ((((0x8e0)) & 0xffff) - (0x0800)) ((0) | (0))
   ((((0x8e4)) & 0xffff) - (0x0800)) ((0) | (0))
   ((((0x8e8)) & 0xffff) - (0x0800)) ((0) | (0))
   ((((0x8ec)) & 0xffff) - (0x0800)) ((0) | (0))
  >;
 };

 mcasp0_pins: mcasp0_pins {
  pinctrl-single,pins = <
   ((((0x9ac)) & 0xffff) - (0x0800)) ((((1 << 5) | (1 << 4))) | (0))
   ((((0x99c)) & 0xffff) - (0x0800)) ((0) | (2))
   ((((0x994)) & 0xffff) - (0x0800)) ((((1 << 4))) | (0))
   ((((0x990)) & 0xffff) - (0x0800)) ((0) | (0))
   ((((0x86c)) & 0xffff) - (0x0800)) ((0) | (7))
  >;
 };
};

&lcdc {
 status = "okay";






 blue-and-red-wiring = "straight";

 port {
  lcdc_0: endpoint@0 {
   remote-endpoint = <&hdmi_0>;
  };
 };
};

&i2c0 {
 tda19988: tda19988@70 {
  compatible = "nxp,tda998x";
  reg = <0x70>;

  pinctrl-names = "default";
  pinctrl-0 = <&nxp_hdmi_bonelt_pins>;




  #sound-dai-cells = <0>;
  audio-ports = < 2 0x03>;

  ports {
   port@0 {
    hdmi_0: endpoint@0 {
     remote-endpoint = <&lcdc_0>;
    };
   };
  };
 };
};

&rtc {
 system-power-controller;
};

&mcasp0 {
 #sound-dai-cells = <0>;
 pinctrl-names = "default";
 pinctrl-0 = <&mcasp0_pins>;
 status = "okay";
 op-mode = <0>;
 tdm-slots = <2>;
 serial-dir = <
   0 0 1 0
  >;
 tx-num-evt = <32>;
 rx-num-evt = <32>;
};

/ {
 clk_mcasp0_fixed: clk_mcasp0_fixed {
  #clock-cells = <0>;
  compatible = "fixed-clock";
  clock-frequency = <24576000>;
 };

 clk_mcasp0: clk_mcasp0 {
  #clock-cells = <0>;
  compatible = "gpio-gate-clock";
  clocks = <&clk_mcasp0_fixed>;
  enable-gpios = <&gpio1 27 0>;
 };

 sound {
  compatible = "simple-audio-card";
  simple-audio-card,name = "TI BeagleBone Black";
  simple-audio-card,format = "i2s";
  simple-audio-card,bitclock-master = <&dailink0_master>;
  simple-audio-card,frame-master = <&dailink0_master>;

  dailink0_master: simple-audio-card,cpu {
   sound-dai = <&mcasp0>;
   clocks = <&clk_mcasp0>;
  };

  simple-audio-card,codec {
   sound-dai = <&tda19988>;
  };
 };
};
# 10 "./src/arm/am335x-boneblack.dts" 2


/ {
 model = "TI AM335x BeagleBone Black";
 compatible = "ti,am335x-bone-black", "ti,am335x-bone", "ti,am33xx";

 chosen {
  base_dtb = "am335x-boneblack.dts";
  base_dtb_timestamp = "Fri May 10 19:26:25 2024";
 };
};

&sgx {
 status = "okay";
};

&cpu0_opp_table {





 oppnitro-1000000000 {
  opp-supported-hw = <0x06 0x0100>;
 };
};
